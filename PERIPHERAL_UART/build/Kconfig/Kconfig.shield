## PERIPHERAL_UART/build/Kconfig/Kconfig.shield
```kconfig
osource "D:/LBS_UART/peripheral_uart/boards/shields/*/Kconfig.shield"
osource "D:/GitHub/romal_practice/ALL_IN_ONE/ALL_IN_ONE/PERIPHERAL_UART/boards/shields/*/Kconfig.shield"
osource "D:/ncs/v2.9.0/nrf/boards/shields/*/Kconfig.shield"
```

## PERIPHERAL_UART/build/Kconfig/Kconfig.shield.defconfig
```kconfig
osource "D:/LBS_UART/peripheral_uart/boards/shields/*/Kconfig.defconfig"
osource "D:/GitHub/romal_practice/ALL_IN_ONE/ALL_IN_ONE/PERIPHERAL_UART/boards/shields/*/Kconfig.defconfig"
osource "D:/ncs/v2.9.0/nrf/boards/shields/*/Kconfig.defconfig"
```

## PERIPHERAL_UART/build/Kconfig/boards/Kconfig.nrf21540dk
```kconfig
# Load board Kconfig descriptions.
osource "D:/ncs/v2.9.0/zephyr/boards/nordic/nrf21540dk/Kconfig.nrf21540dk"
```
